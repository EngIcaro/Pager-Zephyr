## CMakeLists.txt
```
cmake_minimum_required(VERSION 3.13.1)

include($ENV{ZEPHYR_BASE}/cmake/app/boilerplate.cmake NO_POLICY_SCOPE)
project(pager)

list(APPEND HEADERS
    "${PROJECT_BINARY_DIR}/include/generated"
    "${PROJECT_BINARY_DIR}/zephyr/include/generated"
    "${PROJECT_SOURCE_DIR}/include"
    )

list(APPEND SOURCES
    "${PROJECT_SOURCE_DIR}/src/main.c"
    "${PROJECT_SOURCE_DIR}/src/input.c"
    "${PROJECT_SOURCE_DIR}/src/output.c"
    "${PROJECT_SOURCE_DIR}/src/led.c"
    "${PROJECT_SOURCE_DIR}/src/motor.c"
    "${PROJECT_SOURCE_DIR}/src/buzzer.c"
    "${PROJECT_SOURCE_DIR}/src/battery.c"
    "${PROJECT_SOURCE_DIR}/src/thread.c"
    "${PROJECT_SOURCE_DIR}/src/state_machine.c"
    "${PROJECT_SOURCE_DIR}/src/bt_callbacks.c"
    "${PROJECT_SOURCE_DIR}/src/bt_node.c"
    "${PROJECT_SOURCE_DIR}/src/bt_mesh.c"
)

include_directories(${HEADERS})
target_sources(app PRIVATE ${SOURCES})
```

## prj.conf
```kconfig
# Enable debug
CONFIG_PRINTK=y
CONFIG_GPIO=y
CONFIG_SHELL=y
CONFIG_DEVICE_SHELL=y
CONFIG_KERNEL_SHELL=y
CONFIG_UART_CONSOLE=y

# Bluetooth
#CONFIG_INIT_STACKS=y      # if set, lots of noise from mesh/adv.c: STACK_ANALYZE
CONFIG_MAIN_STACK_SIZE=512
CONFIG_SYSTEM_WORKQUEUE_STACK_SIZE=2048

CONFIG_SERIAL=y
CONFIG_STDOUT_CONSOLE=y

CONFIG_BT_SETTINGS=y
CONFIG_FLASH=y
CONFIG_FLASH_PAGE_LAYOUT=y
CONFIG_FLASH_MAP=y
CONFIG_FCB=y
CONFIG_SETTINGS=y
CONFIG_SETTINGS_FCB=y
CONFIG_BT_MESH_RPL_STORE_TIMEOUT=600

CONFIG_BOOT_BANNER=y

CONFIG_BT_OBSERVER=y
CONFIG_BT_BROADCASTER=y
CONFIG_BT_CTLR_DUP_FILTER_LEN=0
CONFIG_BT_CTLR_LE_ENC=n
CONFIG_BT_CTLR_LE_PING=n
CONFIG_BT_DATA_LEN_UPDATE=n
CONFIG_BT_PHY_UPDATE=n
CONFIG_BT_CTLR_CHAN_SEL_2=n
CONFIG_BT_CTLR_MIN_USED_CHAN=n
CONFIG_BT_CTLR_ADV_EXT=n
CONFIG_BT_CTLR_PRIVACY=n

CONFIG_BT_PERIPHERAL=y

CONFIG_BT=y
CONFIG_BT_TINYCRYPT_ECC=y
CONFIG_BT_L2CAP_RX_MTU=69
CONFIG_BT_L2CAP_TX_MTU=69
CONFIG_BT_L2CAP_TX_BUF_COUNT=8

CONFIG_BT_MESH=y
CONFIG_BT_MESH_RELAY=y
CONFIG_BT_MESH_LOW_POWER=n
CONFIG_BT_MESH_FRIEND=n
CONFIG_BT_MESH_FRIEND_QUEUE_SIZE=16
CONFIG_BT_MESH_ADV_BUF_COUNT=20
CONFIG_BT_MESH_TX_SEG_MAX=6

CONFIG_BT_MESH_PB_GATT=y
CONFIG_BT_MESH_PB_ADV=y
CONFIG_BT_MESH_GATT_PROXY=y
CONFIG_BT_MESH_CFG_CLI=y

#CONFIG_BT_MESH_LPN_SCAN_LATENCY=30
#CONFIG_BT_MESH_LPN_RECV_DELAY=40
#CONFIG_BT_MESH_LPN_POLL_TIMEOUT=300

CONFIG_BT_MESH_SUBNET_COUNT=2
CONFIG_BT_MESH_APP_KEY_COUNT=2
CONFIG_BT_MESH_MODEL_KEY_COUNT=2
CONFIG_BT_MESH_MODEL_GROUP_COUNT=2
CONFIG_BT_MESH_LABEL_COUNT=3

#CONFIG_BT_MESH_IV_UPDATE_TEST=y

# this outputs btmon formatted data to the serial port
#CONFIG_BT_DEBUG_MONITOR=y

CONFIG_BT_DEBUG_LOG=y

CONFIG_BT_MESH_DEBUG=y
#CONFIG_BT_MESH_DEBUG_PROV=y
#CONFIG_BT_MESH_DEBUG_PROXY=y
#CONFIG_BT_MESH_DEBUG_BEACON=y
#CONFIG_BT_MESH_DEBUG_NET=y
#CONFIG_BT_MESH_DEBUG_TRANS=y
#CONFIG_BT_MESH_DEBUG_LOW_POWER=y
#CONFIG_BT_MESH_DEBUG_FRIEND=y
#CONFIG_BT_MESH_DEBUG_MODEL=y
#CONFIG_BT_MESH_DEBUG_ACCESS=y
#CONFIG_BT_MESH_DEBUG_CRYPTO=y
#CONFIG_BT_MESH_DEBUG_ADV=y
#CONFIG_BT_MESH_SELF_TEST=y

#CONFIG_BT_HCI_VS_EXT=n

#CONFIG_STACK_USAGE=y

CONFIG_BT_RX_STACK_SIZE=4096

#CONFIG_BT_DEBUG_HCI_DRIVER=y
#CONFIG_BT_DEBUG_HCI_CORE=y
#CONFIG_BT_DEBUG_GATT=y
#CONFIG_BT_DEBUG_CONN=y

CONFIG_BT_MAX_CONN=1
CONFIG_BT_CTLR_RX_BUFFERS=6
CONFIG_BT_CTLR_TX_BUFFERS=4
CONFIG_BT_HCI_CMD_COUNT=4

CONFIG_BT_ATT_PREPARE_COUNT=2

#CONFIG_NET_BUF_SIMPLE_LOG=y
#CONFIG_NET_BUF_LOG=y
#CONFIG_BT_CTLR_DEBUG_PINS=y
```

## src/main.c
```c
#include <zephyr.h>
#include <device.h>
#include <gpio.h>
#include <misc/printk.h>
#include <misc/util.h>
#include <settings/settings.h>
#include <shell/shell.h>
#include <stdlib.h>

#include "bt_callbacks.h"
#include "bt_node.h"
#include "bt_mesh.h"
#include "input.h"
#include "output.h"
#include "led.h"
#include "motor.h"
#include "buzzer.h"
#include "battery.h"
#include "thread.h"
#include "state_machine.h"

/* Shell commands */
static int cmd_call_spin(const struct shell *shell, size_t argc, char **argv) {	
	shell_print(shell, "[SHELL] Spining leds...\n");
	call_leds();
	shell_print(shell, "[SHELL] Done!\n");
	return 0;
}

static int cmd_call_leds(const struct shell *shell, size_t argc, char **argv) {	
	char led = *(*(argv+1));
	shell_print(shell, "[SHELL] Turning on all leds...\n");
	printk(" u8t: %d\n",(u8_t)led - 48);
	set_all_leds((u8_t)led - 48);
	shell_print(shell, "[SHELL] Done!\n");
	return 0;
}

static int cmd_call_led(const struct shell *shell, size_t argc, char **argv) {
	char led = *(*(argv+1));
	char status = *(*(argv+2));
	printk("status do call led %d\n", (int)status);
	if(status == '0') shell_print(shell, "[SHELL] Turning on led %c...\n", led);
	else shell_print(shell, "[SHELL] Turning off led %c...\n", led);
	set_led(led, (u8_t)status - 48);
	shell_print(shell, "[SHELL] Done!\n");
	return 0;
}

static int cmd_call_motor(const struct shell *shell, size_t argc, char **argv) {
	char motor = *(*(argv+1));
	char status = *(*(argv+2));
	if(status == '0') shell_print(shell, "[SHELL] Turning on motor %c...\n", motor);
	else shell_print(shell, "[SHELL] Turning off motor %c...\n", motor);
	set_motor(motor, (u8_t)status - 48);
	shell_print(shell, "[SHELL] Done!\n");
	return 0;
}

static int cmd_call_motors(const struct shell *shell, size_t argc, char **argv) {
	// Acessar: Array de Strings -> String na posição argc+1
	shell_print(shell, "[SHELL] Vibrating...\n");
	call_motors();
	shell_print(shell, "[SHELL] Done!\n");
	return 0;
}

static int cmd_call_buzzer(const struct shell *shell, size_t argc, char **argv) {	
	// char status = *(*(argv+1));
	shell_print(shell, "[SHELL] Beeping...\n");
	alarm();
	shell_print(shell, "[SHELL] Done!\n");
	return 0;
}

/* Shell declaration */
SHELL_STATIC_SUBCMD_SET_CREATE(sub_call,
    SHELL_CMD_ARG(spin, NULL, "Acione animaçao SPIN.", cmd_call_spin, 1, NULL),
	SHELL_CMD_ARG(led, NULL, "Acione um Led.", cmd_call_led, 3, NULL),
    SHELL_CMD_ARG(leds, NULL, "Acione todos os Leds.", cmd_call_leds, 2, NULL),
    SHELL_CMD_ARG(motor, NULL, "Acione um Motor.", cmd_call_motor, 3, NULL),
    SHELL_CMD_ARG(motors, NULL, "Acione os Motores.", cmd_call_motors, 1, NULL),
    SHELL_CMD_ARG(buzzer, NULL, "Acione o buzzer.", cmd_call_buzzer, 1, NULL),
	SHELL_SUBCMD_SET_END
);

SHELL_CMD_REGISTER(call, &sub_call, "Comandos do pager", NULL);

/* Power-On Self-Test (POST) */
void post() {

	printk("[POST] Running POST...\n");
	k_sleep(K_MSEC(1500));

	if(!leds_configure()){
		printk("[POST] Configuring leds... OK!\n");
	} else{ 
		printk("[POST] Configuring leds... ERROR!\n");
		return;
	}
	set_all_leds(0);
	k_sleep(K_MSEC(1000));
	set_all_leds(1);
	
	if(!motors_configure()){
		printk("[POST] Configuring motors... OK!\n");
	} else{ 
		printk("[POST] Configuring motors... ERROR!\n");
		return;
	}

	set_motor('0', 1);
	set_motor('1', 1);
	k_sleep(K_MSEC(1000));
	set_motor('0', 0);
	set_motor('1', 0);

	if(!buzzer_configure()){
		printk("[POST] Configuring buzzer... OK!\n");
	} else{ 
		printk("[POST] Configuring buzzer... ERROR!\n");
		return;
	}

	set_buzzer(1);
	k_sleep(K_MSEC(1000));
	set_buzzer(0);

	printk("[POST] Everything seems right. PAU NA MAQUINA!\n");
	k_sleep(K_MSEC(1500));
}

/* System Main Loop */
void main(void) {
	k_sleep(K_SECONDS(1));

	/* Execute POST */
	post();

	printk("[SYSTEM] Initializing Pager...\n");
	
	/* Initialize the Bluetooth Subsystem */
	int err;
	err = bt_enable(bt_ready);
	if (err) {
		printk("[BLUETOOTH] Bluetooth init failed with err %d.\n", err);
	}

	while (1) {
		state_machine();
		k_sleep(K_SECONDS(1));
	}
}
```

## include/battery.h
```c
#ifndef _BATTERY_H_
#define _BATTERY_H_

#include <adc.h>
#include <gpio.h>
//#include <math.h>
#include "input.h"
#include "output.h"

/*  Inputs:
 *       METER - battery voltage
 *       PGOOD - power good status indication
 *       CHR   - charging status indication
 *  Outputs:
 *       CE      - charger enable active-low
 *       EN      - input current limit config
 *       SYSOFF  - system enable
*/

//TODO: procurar adc_port
// #define METER_GPIO_PORT   "GPIO_0"
#define PGOOD_GPIO_PORT   "GPIO_0"
#define CHR_GPIO_PORT     "GPIO_0"
#define CE_GPIO_PORT      "GPIO_0"
#define EN1_GPIO_PORT     "GPIO_0"
#define EN2_GPIO_PORT     "GPIO_0"
#define SYSOFF_GPIO_PORT  "GPIO_0"

// #define METER_GPIO_PIN   31
#define PGOOD_GPIO_PIN   27
#define CHR_GPIO_PIN     26
#define CE_GPIO_PIN      30
#define EN1_GPIO_PIN     28
#define EN2_GPIO_PIN     29
#define SYSOFF_GPIO_PIN  25

/* Get battery percentage */
int get_meter();

/* Get PGOOD status */
int get_pgood();

/* Get CHR status */
int get_chr();

/* Set Charger Enable mode */
void set_ce(u8_t value);

/* Set Input Current Limit mode */
void set_en(u8_t value_1, u8_t value_2);

/* Set SYSOFF mode */
void set_sysoff(u8_t value);

/* Configure Battery Pins */
int battery_configure();

#endif
```

## include/bt_callbacks.h
```c
#ifndef _BT_CALLBACKS_H
#define _BT_CALLBACKS_H

#include <bluetooth/bluetooth.h>
#include <bluetooth/mesh.h>
#include <misc/printk.h>
#include <settings/settings.h>
#include "bt_node.h"
#include "state_machine.h"

void gen_onoff_set(struct bt_mesh_model *model,
			       struct bt_mesh_msg_ctx *ctx,
			       struct net_buf_simple *buf);

void gen_onoff_set_unack(struct bt_mesh_model *model,
			             struct bt_mesh_msg_ctx *ctx,
			             struct net_buf_simple *buf);

void gen_onoff_get(struct bt_mesh_model *model,
			       struct bt_mesh_msg_ctx *ctx,
			       struct net_buf_simple *buf);

#endif
```

## include/bt_mesh.h
```c
#ifndef _BT_MESH_H
#define _BT_MESH_H

#include <bluetooth/bluetooth.h>
#include <bluetooth/mesh.h>
#include <misc/printk.h>
#include <settings/settings.h>
#include "bt_callbacks.h"
#include "bt_node.h"

int output_number(bt_mesh_output_action_t action, u32_t number);

int output_string(const char *str);

void prov_complete(u16_t net_idx, u16_t addr);

void prov_reset(void);

void bt_ready(int err);

#endif
```

## include/bt_node.h
```c
#ifndef _BT_NODE_H
#define _BT_NODE_H

#include <bluetooth/bluetooth.h>
#include <bluetooth/mesh.h>
#include <settings/settings.h>
#include "bt_callbacks.h"

/* Model Operation Codes */
#define BT_MESH_MODEL_OP_GEN_ONOFF_GET			BT_MESH_MODEL_OP_2(0x82, 0x01)
#define BT_MESH_MODEL_OP_GEN_ONOFF_SET			BT_MESH_MODEL_OP_2(0x82, 0x02)
#define BT_MESH_MODEL_OP_GEN_ONOFF_SET_UNACK	BT_MESH_MODEL_OP_2(0x82, 0x03)
#define BT_MESH_MODEL_OP_GEN_ONOFF_STATUS		BT_MESH_MODEL_OP_2(0x82, 0x04)

/* Element Status */
#define ON 	1
#define OFF 0

/* Element Context */
struct onoff_state {
	u8_t current;
	u8_t previous;
};

extern struct onoff_state onoff_state;
extern const struct bt_mesh_comp comp;

#endif
```

## include/buzzer.h
```c
#ifndef _BUZZER_H_
#define _BUZZER_H_

#include <gpio.h>
#include "output.h"

#define SLEEP_BUZZER 3	//seconds

int buzzer_configure();

void set_buzzer(u8_t value);

void alarm();

#endif
```

## include/ic_logging.h
```c
#ifndef _IC_LOGGING_H_
#define _IC_LOGGING_H_
#include <zephyr.h>

void ic_log_err(char *message);
void ic_log_wrn(char *message);
void ic_log_inf(char *message);
void ic_log_dbg(char *message);
void ic_log_version();
void ic_log_version_inc_build();

#if 0
#define IC_LOG_ERR(x)                                              \
    printk("\033[1;31m");                                          \
    printk("[ERR] %s.%s[%d]: ", __FILE__, __FUNCTION__, __LINE__); \
    printk(x);                                                     \
    printk("\n\033[0m")
#define IC_LOG_WRN(x)                                              \
    printk("\033[1;33m");                                          \
    printk("[WRN] %s.%s[%d]: ", __FILE__, __FUNCTION__, __LINE__); \
    printk(x);                                                     \
    printk("\n\033[0m")
#define IC_LOG_INF(x)                                              \
    printk("\033[1;34m");                                          \
    printk("[INF] %s.%s[%d]: ", __FILE__, __FUNCTION__, __LINE__); \
    printk(x);                                                     \
    printk("\n\033[0m")
#define IC_LOG_DBG(x)                                              \
    printk("[DBG] %s.%s[%d]: ", __FILE__, __FUNCTION__, __LINE__); \
    printk(x);                                                     \
    printk("\n")

#else
#define IC_LOG_ERR(x)
#define IC_LOG_WRN(x)
#define IC_LOG_INF(x)
#define IC_LOG_DBG(x)
#endif

#endif  // !_IC_LOGGING_H_
```

## include/input.h
```c
/**
 * @file   input.h
 *
 * @author Icaro Gabriel Paiva Bastos
 *
 * @date   Mon Aug 6 2019
 *
 * @brief  Header file para o driver input
 *
 *
 */

#ifndef _INPUT_H_
#define _INPUT_H_

#include <misc/printk.h>
#include <device.h>
#include <gpio.h>

struct input {
    struct device *device;
    struct gpio_callback gpio_callback;
    char *dev_label;
    u32_t pin;
};

typedef struct input input_t;

/**
 * Essa função tem como objetivo iniciar o device do driver
 * de entrada.
 * @param in
 *
 * @return
 */
int input_open(input_t *in, char *dev_label);

/**
 * Essa função tem como objetivo configurar o pino de entrada.
 *
 * @param in
 * @param pin
 * @param flags
 * @param cb
 *
 * @return
 */
int input_configure(input_t *in, u32_t pin, int flags);

/**
 * Essa função tem como objetivo fazer uma leitura do pino
 * de entrada.
 * @param in
 * @param state
 *
 * @return
 */
int input_read(input_t *in, u32_t *state);

#endif
```

## include/led.h
```c
#ifndef _LED_H_
#define _LED_H_

#include "output.h"

#define SLEEP_LED	250	//mseconds

int leds_configure();

void set_led(char led, u8_t value);

void set_all_leds(u8_t value);

void call_leds();

#endif
```

## include/motor.h
```c
#ifndef _MOTOR_H_
#define _MOTOR_H_

#include "output.h"

#define SLEEP_MOTOR 3	//seconds

int motors_configure();

void set_motor(char motor, u8_t value);

void call_motors();

#endif
```

## include/output.h
```c
/**
 * @file   output.h
 * @author Icaro Gabriel Paiva Bastos
 * @date   Mon Aug  6 2019
 *
 * @brief  Header file para o driver output.
 *
 *
 */

#ifndef _OUTPUT_H_
#define _OUTPUT_H_

#include <device.h>
#include <gpio.h>
#include <misc/printk.h>

struct output {
    struct device *device;
    char *dev_label;
    u32_t pin;
    u8_t state;
};

typedef struct output output_t;

/**
 * Essa função tem como objetivo iniciar o driver output,
 * ou seja, iniciar o device.
 * @param out
 *
 * @return
 */
int output_open(output_t *out, char *dev_label);

/**
 * Essa função tem como objetivo configurar o pino de saída
 * de acordo com suas flags.
 * @param out
 * @param pin
 * @param flags
 *
 * @return
 */
int output_configure(output_t *out, u32_t pin, int flags);

/**
 * Essa função tem como objetivo setar o estado do pino de
 * saída para algum valor.
 * @param out
 * @param value
 *
 * @return
 */
int output_set(output_t *out, u8_t value);

/**
 * Essa função tem como objetivo inverter o estado do pino de
 * saída.
 * @param out
 *
 * @return
 */

#endif
```

## include/stateMachine.h
```c
#ifndef _SATATEMACHINE_H_
#define _SATATEMACHINE_H_

#include <device.h>
#include <gpio.h>
#include "thread.h"

void state_machine();

void set_ready();

void set_waiting();

void set_charging();

#endif
```

## include/state_machine.h
```c
#ifndef _STATE_MACHINE_H_
#define _STATE_MACHINE_H_

#include <device.h>
#include <gpio.h>
#include "thread.h"
#include "bt_node.h"

void state_machine();

void set_ready();

void set_waiting();

void set_charging();

int get_state();

#endif
```
