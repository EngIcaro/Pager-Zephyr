## CMakeLists.txt
```
# SPDX-License-Identifier: Apache-2.0

cmake_minimum_required(VERSION 3.13.1)
include($ENV{ZEPHYR_BASE}/cmake/app/boilerplate.cmake NO_POLICY_SCOPE)
project(chamador_bluetooth)

list(APPEND HEADERS
    "${PROJECT_BINARY_DIR}/include/generated"
    "${PROJECT_BINARY_DIR}/zephyr/include/generated"
    "${PROJECT_SOURCE_DIR}/include"
    )

list(APPEND SOURCES
    "${PROJECT_SOURCE_DIR}/src/main.c"
    "${PROJECT_SOURCE_DIR}/src/bt_callbacks.c"
    "${PROJECT_SOURCE_DIR}/src/bt_node.c"
    "${PROJECT_SOURCE_DIR}/src/bt_mesh.c"
    "${PROJECT_SOURCE_DIR}/src/button.c"
)

include_directories(${HEADERS})
target_sources(app PRIVATE ${SOURCES})
```

## prj.conf
```kconfig
#CONFIG_INIT_STACKS=y      # if set, lots of noise from mesh/adv.c: STACK_ANALYZE
CONFIG_MAIN_STACK_SIZE=512
CONFIG_SYSTEM_WORKQUEUE_STACK_SIZE=2048

CONFIG_GPIO=y
CONFIG_SERIAL=y
CONFIG_STDOUT_CONSOLE=y

CONFIG_BT_SETTINGS=y
CONFIG_FLASH=y
CONFIG_FLASH_PAGE_LAYOUT=y
CONFIG_FLASH_MAP=y
CONFIG_FCB=y
CONFIG_SETTINGS=y
CONFIG_SETTINGS_FCB=y
CONFIG_BT_MESH_RPL_STORE_TIMEOUT=600

CONFIG_BOOT_BANNER=y

CONFIG_BT_OBSERVER=y
CONFIG_BT_BROADCASTER=y
CONFIG_BT_CTLR_DUP_FILTER_LEN=0
CONFIG_BT_CTLR_LE_ENC=n
CONFIG_BT_CTLR_LE_PING=n
CONFIG_BT_DATA_LEN_UPDATE=n
CONFIG_BT_PHY_UPDATE=n
CONFIG_BT_CTLR_CHAN_SEL_2=n
CONFIG_BT_CTLR_MIN_USED_CHAN=n
CONFIG_BT_CTLR_ADV_EXT=n
CONFIG_BT_CTLR_PRIVACY=n

CONFIG_BT_PERIPHERAL=y

CONFIG_BT=y
CONFIG_BT_TINYCRYPT_ECC=y
CONFIG_BT_L2CAP_RX_MTU=69
CONFIG_BT_L2CAP_TX_MTU=69
CONFIG_BT_L2CAP_TX_BUF_COUNT=8

CONFIG_BT_MESH=y
CONFIG_BT_MESH_RELAY=y
CONFIG_BT_MESH_LOW_POWER=n
CONFIG_BT_MESH_FRIEND=n
CONFIG_BT_MESH_FRIEND_QUEUE_SIZE=16
CONFIG_BT_MESH_ADV_BUF_COUNT=20
CONFIG_BT_MESH_TX_SEG_MAX=6

CONFIG_BT_MESH_PB_GATT=y
CONFIG_BT_MESH_PB_ADV=y
CONFIG_BT_MESH_GATT_PROXY=y
CONFIG_BT_MESH_CFG_CLI=y

#CONFIG_BT_MESH_LPN_SCAN_LATENCY=30
#CONFIG_BT_MESH_LPN_RECV_DELAY=40
#CONFIG_BT_MESH_LPN_POLL_TIMEOUT=300

CONFIG_BT_MESH_SUBNET_COUNT=2
CONFIG_BT_MESH_APP_KEY_COUNT=2
CONFIG_BT_MESH_MODEL_KEY_COUNT=2
CONFIG_BT_MESH_MODEL_GROUP_COUNT=2
CONFIG_BT_MESH_LABEL_COUNT=3

#CONFIG_BT_MESH_IV_UPDATE_TEST=y

CONFIG_UART_CONSOLE=y

# this outputs btmon formatted data to the serial port
#CONFIG_BT_DEBUG_MONITOR=y

CONFIG_BT_DEBUG_LOG=y

CONFIG_BT_MESH_DEBUG=y
#CONFIG_BT_MESH_DEBUG_PROV=y
#CONFIG_BT_MESH_DEBUG_PROXY=y
#CONFIG_BT_MESH_DEBUG_BEACON=y
#CONFIG_BT_MESH_DEBUG_NET=y
#CONFIG_BT_MESH_DEBUG_TRANS=y
#CONFIG_BT_MESH_DEBUG_LOW_POWER=y
#CONFIG_BT_MESH_DEBUG_FRIEND=y
#CONFIG_BT_MESH_DEBUG_MODEL=y
#CONFIG_BT_MESH_DEBUG_ACCESS=y
#CONFIG_BT_MESH_DEBUG_CRYPTO=y
#CONFIG_BT_MESH_DEBUG_ADV=y
#CONFIG_BT_MESH_SELF_TEST=y

#CONFIG_BT_HCI_VS_EXT=n

#CONFIG_STACK_USAGE=y

CONFIG_BT_RX_STACK_SIZE=4096

#CONFIG_BT_DEBUG_HCI_DRIVER=y
#CONFIG_BT_DEBUG_HCI_CORE=y
#CONFIG_BT_DEBUG_GATT=y
#CONFIG_BT_DEBUG_CONN=y

CONFIG_BT_MAX_CONN=1
CONFIG_BT_CTLR_RX_BUFFERS=6
CONFIG_BT_CTLR_TX_BUFFERS=4
CONFIG_BT_HCI_CMD_COUNT=4

CONFIG_BT_ATT_PREPARE_COUNT=2

#CONFIG_NET_BUF_SIMPLE_LOG=y
#CONFIG_NET_BUF_LOG=y
#CONFIG_BT_CTLR_DEBUG_PINS=y
```

## src/main.c
```c
#include <zephyr.h>
#include <misc/printk.h>
#include <misc/util.h>
#include <settings/settings.h>
#include <stdio.h>

#include "bt_callbacks.h"
#include "bt_node.h"
#include "bt_mesh.h"
#include "button.h"

void main(void) {
	int err;

	printk("[SYSTEM] Initializing Caller...\n");

	/* Initialize the Bluetooth Subsystem */
	err = bt_enable(bt_ready);
	if (err) {
		printk("[BLUETOOTH] Bluetooth init failed with err %d.\n", err);
	}
	
	button_init();

	/**************** TESTE ***************/
	// init_led(0, LED0_GPIO_CONTROLLER, LED0_GPIO_PIN);
	
	//while(1) {
	//	gpio_pin_write(led_device, LED0_GPIO_PIN, 1);
	//	k_sleep(1000);
	//	gpio_pin_write(led_device, LED0_GPIO_PIN, 0);
	//	k_sleep(1000);
	//}
	/**************** TESTE ***************/
}

// TODO: implementar get para saber status do servidor sem precisar dar set
```

## include/bt_callbacks.h
```c
#ifndef _BT_CALLBACKS_H
#define _BT_CALLBACKS_H

#include <bluetooth/bluetooth.h>
#include <bluetooth/mesh.h>
#include <misc/printk.h>
#include <settings/settings.h>

void gen_onoff_status(struct bt_mesh_model *model,
			          struct bt_mesh_msg_ctx *ctx,
			          struct net_buf_simple *buf);

#endif
```

## include/bt_mesh.h
```c
#ifndef _BT_MESH_H
#define _BT_MESH_H

#include <bluetooth/bluetooth.h>
#include <bluetooth/mesh.h>
#include <misc/printk.h>
#include <settings/settings.h>

#include "bt_callbacks.h"
#include "bt_node.h"

int output_number(bt_mesh_output_action_t action, u32_t number);

int output_string(const char *str);

void prov_complete(u16_t net_idx, u16_t addr);

void prov_reset(void);

void bt_ready(int err);

#endif
```

## include/bt_node.h
```c
#ifndef _BT_NODE_H
#define _BT_NODE_H

#include <bluetooth/bluetooth.h>
#include <bluetooth/mesh.h>
#include <settings/settings.h>

#include "bt_callbacks.h"

/* Model Operation Codes */
#define BT_MESH_MODEL_OP_GEN_ONOFF_GET		    BT_MESH_MODEL_OP_2(0x82, 0x01)
#define BT_MESH_MODEL_OP_GEN_ONOFF_SET		    BT_MESH_MODEL_OP_2(0x82, 0x02)
#define BT_MESH_MODEL_OP_GEN_ONOFF_SET_UNACK	BT_MESH_MODEL_OP_2(0x82, 0x03)
#define BT_MESH_MODEL_OP_GEN_ONOFF_STATUS	    BT_MESH_MODEL_OP_2(0x82, 0x04)

/* Element Status */
#define ON 	1
#define OFF 0

/* Element Context */
struct onoff_state {
	u8_t current;
	u8_t previous;
};

extern struct bt_mesh_model root_models[];
extern const struct bt_mesh_comp comp;

#endif
```

## include/button.h
```c
#ifndef _BUTTON_H
#define _BUTTON_H

#include <gpio.h>
#include <misc/printk.h>
#include <settings/settings.h>

#include "bt_callbacks.h"
#include "bt_node.h"
#include "bt_mesh.h"

#define BUTTON_0_CONTROLLER 	SW0_GPIO_CONTROLLER
#define BUTTON_0_PIN 			SW0_GPIO_PIN

#define FLAGS 					(GPIO_DIR_IN | GPIO_INT | GPIO_INT_EDGE | GPIO_INT_ACTIVE_LOW | GPIO_PUD_PULL_UP)
#define BUTTON_PRESS_INTERVAL_SEC 	1
#define BUTTON_DEBOUNCE_DELAY_MS 	250

struct sw {
	u8_t onoff_state;
	struct k_work button_work;
	struct k_timer button_timer;
};

void button_pressed(struct device *dev, struct gpio_callback *cb, u32_t pin_pos);

void button_cnt_timer(struct k_timer *work);

void button_pressed_worker(struct k_work *work);

void button_init();

#endif
```

## src/bt_callbacks.c
```c
#include "bt_callbacks.h"

/* Generic OnOff Model Client Message Handlers */
/* Mesh Model Specification 3.1.1 */
void gen_onoff_status(struct bt_mesh_model *model,
			          struct bt_mesh_msg_ctx *ctx,
			          struct net_buf_simple *buf) {
	u8_t state;

	state = net_buf_simple_pull_u8(buf);

	// printk("Node 0x%04x OnOff status from 0x%04x with state 0x%02x\n",
	//        bt_mesh_model_elem(model)->addr, ctx->addr, state);
	printk("[BLUETOOTH] Node 0x%04x from 0x%04x has state 0x%02x.\n",
	       bt_mesh_model_elem(model)->addr, ctx->addr, state);
}
```

## src/bt_mesh.c
```c
#include "bt_mesh.h"

/* Bluetooth Mesh Provisioning */
static u8_t dev_uuid[16] = { 0xdd, 0xdd };
u16_t primary_addr;
u16_t primary_net_idx;

int output_number(bt_mesh_output_action_t action, u32_t number) {
	printk("[BLUETOOTH] OOB Number %06u.\n", number);
	return 0;
}

int output_string(const char *str) {
	printk("[BLUETOOTH] OOB String %s.\n", str);
	return 0;
}

void prov_complete(u16_t net_idx, u16_t addr) {
	printk("[BLUETOOTH] Provisioning complete for net_idx 0x%04x, address 0x%04x.\n", net_idx, addr);
	primary_addr    = addr;
	primary_net_idx = net_idx;
}

void prov_reset(void) {
	bt_mesh_prov_enable(BT_MESH_PROV_ADV | BT_MESH_PROV_GATT);
	printk("[BLUETOOTH] Provisioning reset.\n");
}

const struct bt_mesh_prov prov = {
	.uuid           = dev_uuid,
	.output_size    = 6,
	.output_actions = (BT_MESH_DISPLAY_NUMBER | BT_MESH_DISPLAY_STRING),
	.output_number  = output_number,
	.output_string  = output_string,
	.complete       = prov_complete,
	.reset          = prov_reset,
};

/* Bluetooth Ready Callback */
void bt_ready(int err) {
	if (err) {
		printk("[BLUETOOTH] Bluetooth init failed with err %d.\n", err);
		return;
	}

	printk("[BLUETOOTH] Bluetooth initialized.\n");

	err = bt_mesh_init(&prov, &comp);
	if (err) {
		printk("[BLUETOOTH] Initializing mesh failed with err %d.\n", err);
		return;
	}

	if (IS_ENABLED(CONFIG_SETTINGS)) {
		settings_load();
	}

	bt_mesh_prov_enable(BT_MESH_PROV_GATT | BT_MESH_PROV_ADV);

	printk("[BLUETOOTH] Mesh initialized.\n");
}
```

## src/bt_node.c
```c
#include "bt_node.h"

/* Declare and Initialize Element Context */
struct onoff_state onoff_state = {
	.current    = OFF,
	.previous   = ON,
};

/* Server Configuration Declaration */
struct bt_mesh_cfg_srv cfg_srv = {
	.relay              = BT_MESH_RELAY_ENABLED,
	.beacon             = BT_MESH_BEACON_DISABLED,
	.frnd               = BT_MESH_FRIEND_NOT_SUPPORTED,
	.gatt_proxy         = BT_MESH_GATT_PROXY_ENABLED,
	.default_ttl        = 7,
	.net_transmit       = BT_MESH_TRANSMIT(1, 20),
	.relay_retransmit   = BT_MESH_TRANSMIT(1, 20),
};

/* Health Server Declaration */
static struct bt_mesh_health_srv health_srv = {};

/* Client Configuration Declaration */
static struct bt_mesh_cfg_cli cfg_cli = {};

/* Publication Declarations */
BT_MESH_HEALTH_PUB_DEFINE(health_pub, 0);
BT_MESH_MODEL_PUB_DEFINE(gen_onoff_pub_cli, NULL, 2 + 2);

/* OnOff Model Client Op Dispatch Table */
const struct bt_mesh_model_op gen_onoff_cli_op[] = {
	{ BT_MESH_MODEL_OP_GEN_ONOFF_STATUS, 1, gen_onoff_status },
	  BT_MESH_MODEL_OP_END,
};

/* Element Model Declarations */
struct bt_mesh_model root_models[] = {
	BT_MESH_MODEL_CFG_SRV(&cfg_srv),
	BT_MESH_MODEL_CFG_CLI(&cfg_cli),
	BT_MESH_MODEL_HEALTH_SRV(&health_srv, &health_pub),
	BT_MESH_MODEL(BT_MESH_MODEL_ID_GEN_ONOFF_CLI, gen_onoff_cli_op,
		          &gen_onoff_pub_cli, &onoff_state),
};

/* Root Element Declaration */
struct bt_mesh_elem elements[] = {
	BT_MESH_ELEM(0, root_models, BT_MESH_MODEL_NONE),
};

/* Node Declaration */
const struct bt_mesh_comp comp = {
	.cid        = BT_COMP_ID_LF,
	.elem       = elements,
	.elem_count = ARRAY_SIZE(elements),
};
```

## src/button.c
```c
#include "button.h"

struct sw sw;
struct device *sw_device;
struct gpio_callback button_cb;

u8_t button_press_cnt;
u8_t trans_id;
u32_t time, last_time;

/*
 * One button press within a BUTTON_PRESS_INTERVAL_SEC sends an ON message
 * More than one sends an OFF message
 */

/* Button Pressed Event Handler */
void button_pressed(struct device *dev, struct gpio_callback *cb, u32_t pin) {
	
	time = k_uptime_get_32();

	/* Debounce the switch within a BUTTON_DEBOUNCE_DELAY_MS */
	if (time < last_time + BUTTON_DEBOUNCE_DELAY_MS) {
		last_time = time;
		return;
	}

	/* If button was pressed only one time, start counting BUTTON_PRESS_INTERVAL_SEC */
	if (button_press_cnt == 0U) {
		k_timer_start(&sw.button_timer, K_SECONDS(BUTTON_PRESS_INTERVAL_SEC), 0);
	}

	printk("[BUTTON] Button pressed.\n");
	button_press_cnt++;

	/* Save last time button was pressed for debounce purposes */
	last_time = time;
}

/* Button Count Timer Worker */
void button_cnt_timer(struct k_timer *work) {

	struct sw *button_sw = CONTAINER_OF(work, struct sw, button_timer);
	
	button_sw->onoff_state = button_press_cnt == 1U ? 1 : 0;
	printk("[BUTTON] Button was pressed 0x%02x time(s), setting state 0x%02x.\n",
	       button_press_cnt, button_sw->onoff_state);
	button_press_cnt = 0U;
	k_work_submit(&sw.button_work);
}

/**************** TESTE ***************/
struct device *led_device;

void init_led(u8_t dev, const char *port, u32_t pin_num)
{
	led_device = device_get_binding(port);
	gpio_pin_configure(led_device,
			   pin_num, GPIO_DIR_OUT | GPIO_PUD_PULL_UP);
}
/**************** TESTE ***************/

/* Button Pressed Worker Task */
void button_pressed_worker(struct k_work *work) {
	struct bt_mesh_model *mod_cli;
	struct bt_mesh_model_pub *pub_cli;
	struct sw *sw = CONTAINER_OF(work, struct sw, button_work);
	int err;

	/* Get Generic OnOff Client Model from Root */
	mod_cli = &root_models[3];
	pub_cli = mod_cli->pub;
	
	/**************** TESTE ***************/
	init_led(0, LED0_GPIO_CONTROLLER, LED0_GPIO_PIN);
	/**************** TESTE ***************/

	/* In case publish address is not defined yet */
	if (pub_cli->addr == BT_MESH_ADDR_UNASSIGNED) {
		/**************** TESTE ***************/
		gpio_pin_write(led_device, LED0_GPIO_PIN, 0);
		k_sleep(500);
		gpio_pin_write(led_device, LED0_GPIO_PIN, 1);
		k_sleep(500);
		/**************** TESTE ***************/
		printk("[BLUETOOTH] Publish address unassigned. Please, set a Publish Address for the OnOff Client.\n");
		return;
	}

	/**************** TESTE ***************/
	gpio_pin_write(led_device, LED0_GPIO_PIN, 0);
	k_sleep(500);
	gpio_pin_write(led_device, LED0_GPIO_PIN, 1);
	k_sleep(500);
	gpio_pin_write(led_device, LED0_GPIO_PIN, 0);
	k_sleep(500);
	gpio_pin_write(led_device, LED0_GPIO_PIN, 1);
	k_sleep(500);
	gpio_pin_write(led_device, LED0_GPIO_PIN, 0);
	k_sleep(500);
	gpio_pin_write(led_device, LED0_GPIO_PIN, 1);
	k_sleep(500);
	gpio_pin_write(led_device, LED0_GPIO_PIN, 0);
	k_sleep(500);
	gpio_pin_write(led_device, LED0_GPIO_PIN, 1);
	k_sleep(500);
	/**************** TESTE ***************/

	/* Publishing message */
	printk("[BLUETOOTH] Publishing state 0x%04x to address 0x%04x.\n",
	       sw->onoff_state, pub_cli->addr);
	bt_mesh_model_msg_init(pub_cli->msg, BT_MESH_MODEL_OP_GEN_ONOFF_SET);
	net_buf_simple_add_u8(pub_cli->msg, sw->onoff_state);
	net_buf_simple_add_u8(pub_cli->msg, trans_id++);
	err = bt_mesh_model_publish(mod_cli);

	if (err) {
		printk("[BLUETOOTH] Publishing failed with err %d.\n", err);
		/**************** TESTE ***************/
		// gpio_pin_write(led_device, LED0_GPIO_PIN, 0);
		// k_sleep(500);
		// gpio_pin_write(led_device, LED0_GPIO_PIN, 1);
		// k_sleep(500);
		// gpio_pin_write(led_device, LED0_GPIO_PIN, 0);
		// k_sleep(500);
		// gpio_pin_write(led_device, LED0_GPIO_PIN, 1);
		// k_sleep(500);
		// gpio_pin_write(led_device, LED0_GPIO_PIN, 0);
		// k_sleep(500);
		// gpio_pin_write(led_device, LED0_GPIO_PIN, 1);
		// k_sleep(500);
		/**************** TESTE ***************/
	}
}

void button_init() {
    /* Initialize button debouncer */
	last_time = k_uptime_get_32();

	/* Initialize button worker task */
	k_work_init(&sw.button_work, button_pressed_worker);
	
	/* Initialize button count timer */
	k_timer_init(&sw.button_timer, button_cnt_timer, NULL);

	/* Initialize button */
    sw_device = device_get_binding(BUTTON_0_CONTROLLER);
	gpio_pin_configure(sw_device, BUTTON_0_PIN, FLAGS);
	gpio_init_callback(&button_cb, button_pressed, BIT(BUTTON_0_PIN));
	gpio_add_callback(sw_device, &button_cb);
	gpio_pin_enable_callback(sw_device, BUTTON_0_PIN);
}
```
